#pragma once
/*
    #version:1# (machine generated, don't edit!)

    Generated by sokol-shdc (https://github.com/floooh/sokol-tools)

    Cmdline: sokol-shdc --input object_shadow.glsl --output object_shadow.h --slang glsl330:glsl300es:hlsl5:metal_macos:metal_ios:metal_sim --format=sokol --reflection --ifdef --module object_shadow

    Overview:

        Shader program 'program':
            Get shader desc: object_shadow_program_shader_desc(sg_query_backend());
            Vertex shader: vs
                Attribute slots:
                    ATTR_object_shadow_vs_vs_position = 0
                Uniform block 'object_shadow_vs_params':
                    C struct: object_shadow_object_shadow_vs_params_t
                    Bind slot: SLOT_object_shadow_object_shadow_vs_params = 0
            Fragment shader: fs


    Shader descriptor structs:

        sg_shader program = sg_make_shader(object_shadow_program_shader_desc(sg_query_backend()));

    Vertex attribute locations for vertex shader 'vs':

        sg_pipeline pip = sg_make_pipeline(&(sg_pipeline_desc){
            .layout = {
                .attrs = {
                    [ATTR_object_shadow_vs_vs_position] = { ... },
                },
            },
            ...});


    Image bind slots, use as index in sg_bindings.vs.images[] or .fs.images[]


    Sampler bind slots, use as index in sg_bindings.vs.sampler[] or .fs.samplers[]


    Bind slot and C-struct for uniform block 'object_shadow_vs_params':

        object_shadow_object_shadow_vs_params_t object_shadow_vs_params = {
            .un_mvp = ...;
        };
        sg_apply_uniforms(SG_SHADERSTAGE_[VS|FS], SLOT_object_shadow_object_shadow_vs_params, &SG_RANGE(object_shadow_vs_params));

*/
#include <stdint.h>
#include <stdbool.h>
#include <string.h>
#include <stddef.h>
#if !defined(SOKOL_SHDC_ALIGN)
  #if defined(_MSC_VER)
    #define SOKOL_SHDC_ALIGN(a) __declspec(align(a))
  #else
    #define SOKOL_SHDC_ALIGN(a) __attribute__((aligned(a)))
  #endif
#endif
#define ATTR_object_shadow_vs_vs_position (0)
#define SLOT_object_shadow_object_shadow_vs_params (0)
#pragma pack(push,1)
SOKOL_SHDC_ALIGN(16) typedef struct object_shadow_object_shadow_vs_params_t {
    Mat4f un_mvp;
} object_shadow_object_shadow_vs_params_t;
#pragma pack(pop)
#if defined(SOKOL_GLCORE33)
/*
    #version 330
    
    uniform vec4 object_shadow_vs_params[4];
    layout(location = 0) in vec3 vs_position;
    
    void main()
    {
        gl_Position = mat4(object_shadow_vs_params[0], object_shadow_vs_params[1], object_shadow_vs_params[2], object_shadow_vs_params[3]) * vec4(vs_position, 1.0);
        gl_Position.z = 2.0 * gl_Position.z - gl_Position.w;
    }
    
*/
static const char object_shadow_vs_source_glsl330[334] = {
    0x23,0x76,0x65,0x72,0x73,0x69,0x6f,0x6e,0x20,0x33,0x33,0x30,0x0a,0x0a,0x75,0x6e,
    0x69,0x66,0x6f,0x72,0x6d,0x20,0x76,0x65,0x63,0x34,0x20,0x6f,0x62,0x6a,0x65,0x63,
    0x74,0x5f,0x73,0x68,0x61,0x64,0x6f,0x77,0x5f,0x76,0x73,0x5f,0x70,0x61,0x72,0x61,
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    0x73,0x69,0x74,0x69,0x6f,0x6e,0x2e,0x77,0x3b,0x0a,0x7d,0x0a,0x0a,0x00,
};
/*
    #version 330
    
    void main()
    {
    }
    
*/
static const char object_shadow_fs_source_glsl330[32] = {
    0x23,0x76,0x65,0x72,0x73,0x69,0x6f,0x6e,0x20,0x33,0x33,0x30,0x0a,0x0a,0x76,0x6f,
    0x69,0x64,0x20,0x6d,0x61,0x69,0x6e,0x28,0x29,0x0a,0x7b,0x0a,0x7d,0x0a,0x0a,0x00,

};
#endif /* SOKOL_GLCORE33 */
#if defined(SOKOL_GLES3)
/*
    #version 300 es
    
    uniform vec4 object_shadow_vs_params[4];
    layout(location = 0) in vec3 vs_position;
    
    void main()
    {
        gl_Position = mat4(object_shadow_vs_params[0], object_shadow_vs_params[1], object_shadow_vs_params[2], object_shadow_vs_params[3]) * vec4(vs_position, 1.0);
        gl_Position.z = 2.0 * gl_Position.z - gl_Position.w;
    }
    
*/
static const char object_shadow_vs_source_glsl300es[337] = {
    0x23,0x76,0x65,0x72,0x73,0x69,0x6f,0x6e,0x20,0x33,0x30,0x30,0x20,0x65,0x73,0x0a,
    0x0a,0x75,0x6e,0x69,0x66,0x6f,0x72,0x6d,0x20,0x76,0x65,0x63,0x34,0x20,0x6f,0x62,
    0x6a,0x65,0x63,0x74,0x5f,0x73,0x68,0x61,0x64,0x6f,0x77,0x5f,0x76,0x73,0x5f,0x70,
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    0x00,
};
/*
    #version 300 es
    precision mediump float;
    precision highp int;
    
    void main()
    {
    }
    
*/
static const char object_shadow_fs_source_glsl300es[81] = {
    0x23,0x76,0x65,0x72,0x73,0x69,0x6f,0x6e,0x20,0x33,0x30,0x30,0x20,0x65,0x73,0x0a,
    0x70,0x72,0x65,0x63,0x69,0x73,0x69,0x6f,0x6e,0x20,0x6d,0x65,0x64,0x69,0x75,0x6d,
    0x70,0x20,0x66,0x6c,0x6f,0x61,0x74,0x3b,0x0a,0x70,0x72,0x65,0x63,0x69,0x73,0x69,
    0x6f,0x6e,0x20,0x68,0x69,0x67,0x68,0x70,0x20,0x69,0x6e,0x74,0x3b,0x0a,0x0a,0x76,
    0x6f,0x69,0x64,0x20,0x6d,0x61,0x69,0x6e,0x28,0x29,0x0a,0x7b,0x0a,0x7d,0x0a,0x0a,
    0x00,
};
#endif /* SOKOL_GLES3 */
#if defined(SOKOL_D3D11)
/*
    cbuffer object_shadow_vs_params : register(b0)
    {
        row_major float4x4 _19_un_mvp : packoffset(c0);
    };
    
    
    static float4 gl_Position;
    static float3 vs_position;
    
    struct SPIRV_Cross_Input
    {
        float3 vs_position : TEXCOORD0;
    };
    
    struct SPIRV_Cross_Output
    {
        float4 gl_Position : SV_Position;
    };
    
    void vert_main()
    {
        gl_Position = mul(float4(vs_position, 1.0f), _19_un_mvp);
    }
    
    SPIRV_Cross_Output main(SPIRV_Cross_Input stage_input)
    {
        vs_position = stage_input.vs_position;
        vert_main();
        SPIRV_Cross_Output stage_output;
        stage_output.gl_Position = gl_Position;
        return stage_output;
    }
*/
static const char object_shadow_vs_source_hlsl5[608] = {
    0x63,0x62,0x75,0x66,0x66,0x65,0x72,0x20,0x6f,0x62,0x6a,0x65,0x63,0x74,0x5f,0x73,
    0x68,0x61,0x64,0x6f,0x77,0x5f,0x76,0x73,0x5f,0x70,0x61,0x72,0x61,0x6d,0x73,0x20,
    0x3a,0x20,0x72,0x65,0x67,0x69,0x73,0x74,0x65,0x72,0x28,0x62,0x30,0x29,0x0a,0x7b,
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    0x74,0x61,0x67,0x65,0x5f,0x6f,0x75,0x74,0x70,0x75,0x74,0x3b,0x0a,0x7d,0x0a,0x00,

};
/*
    void frag_main()
    {
    }
    
    void main()
    {
        frag_main();
    }
*/
static const char object_shadow_fs_source_hlsl5[56] = {
    0x76,0x6f,0x69,0x64,0x20,0x66,0x72,0x61,0x67,0x5f,0x6d,0x61,0x69,0x6e,0x28,0x29,
    0x0a,0x7b,0x0a,0x7d,0x0a,0x0a,0x76,0x6f,0x69,0x64,0x20,0x6d,0x61,0x69,0x6e,0x28,
    0x29,0x0a,0x7b,0x0a,0x20,0x20,0x20,0x20,0x66,0x72,0x61,0x67,0x5f,0x6d,0x61,0x69,
    0x6e,0x28,0x29,0x3b,0x0a,0x7d,0x0a,0x00,
};
#endif /* SOKOL_D3D11 */
#if defined(SOKOL_METAL)
/*
    #include <metal_stdlib>
    #include <simd/simd.h>
    
    using namespace metal;
    
    struct object_shadow_vs_params
    {
        float4x4 un_mvp;
    };
    
    struct main0_out
    {
        float4 gl_Position [[position]];
    };
    
    struct main0_in
    {
        float3 vs_position [[attribute(0)]];
    };
    
    vertex main0_out main0(main0_in in [[stage_in]], constant object_shadow_vs_params& _19 [[buffer(0)]])
    {
        main0_out out = {};
        out.gl_Position = _19.un_mvp * float4(in.vs_position, 1.0);
        return out;
    }
    
*/
static const char object_shadow_vs_source_metal_macos[465] = {
    0x23,0x69,0x6e,0x63,0x6c,0x75,0x64,0x65,0x20,0x3c,0x6d,0x65,0x74,0x61,0x6c,0x5f,
    0x73,0x74,0x64,0x6c,0x69,0x62,0x3e,0x0a,0x23,0x69,0x6e,0x63,0x6c,0x75,0x64,0x65,
    0x20,0x3c,0x73,0x69,0x6d,0x64,0x2f,0x73,0x69,0x6d,0x64,0x2e,0x68,0x3e,0x0a,0x0a,
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    0x00,
};
/*
    #include <metal_stdlib>
    #include <simd/simd.h>
    
    using namespace metal;
    
    fragment void main0()
    {
    }
    
*/
static const char object_shadow_fs_source_metal_macos[100] = {
    0x23,0x69,0x6e,0x63,0x6c,0x75,0x64,0x65,0x20,0x3c,0x6d,0x65,0x74,0x61,0x6c,0x5f,
    0x73,0x74,0x64,0x6c,0x69,0x62,0x3e,0x0a,0x23,0x69,0x6e,0x63,0x6c,0x75,0x64,0x65,
    0x20,0x3c,0x73,0x69,0x6d,0x64,0x2f,0x73,0x69,0x6d,0x64,0x2e,0x68,0x3e,0x0a,0x0a,
    0x75,0x73,0x69,0x6e,0x67,0x20,0x6e,0x61,0x6d,0x65,0x73,0x70,0x61,0x63,0x65,0x20,
    0x6d,0x65,0x74,0x61,0x6c,0x3b,0x0a,0x0a,0x66,0x72,0x61,0x67,0x6d,0x65,0x6e,0x74,
    0x20,0x76,0x6f,0x69,0x64,0x20,0x6d,0x61,0x69,0x6e,0x30,0x28,0x29,0x0a,0x7b,0x0a,
    0x7d,0x0a,0x0a,0x00,
};
#endif /* SOKOL_METAL */
#if defined(SOKOL_METAL)
/*
    #include <metal_stdlib>
    #include <simd/simd.h>
    
    using namespace metal;
    
    struct object_shadow_vs_params
    {
        float4x4 un_mvp;
    };
    
    struct main0_out
    {
        float4 gl_Position [[position]];
    };
    
    struct main0_in
    {
        float3 vs_position [[attribute(0)]];
    };
    
    vertex main0_out main0(main0_in in [[stage_in]], constant object_shadow_vs_params& _19 [[buffer(0)]])
    {
        main0_out out = {};
        out.gl_Position = _19.un_mvp * float4(in.vs_position, 1.0);
        return out;
    }
    
*/
static const char object_shadow_vs_source_metal_ios[465] = {
    0x23,0x69,0x6e,0x63,0x6c,0x75,0x64,0x65,0x20,0x3c,0x6d,0x65,0x74,0x61,0x6c,0x5f,
    0x73,0x74,0x64,0x6c,0x69,0x62,0x3e,0x0a,0x23,0x69,0x6e,0x63,0x6c,0x75,0x64,0x65,
    0x20,0x3c,0x73,0x69,0x6d,0x64,0x2f,0x73,0x69,0x6d,0x64,0x2e,0x68,0x3e,0x0a,0x0a,
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    0x00,
};
/*
    #include <metal_stdlib>
    #include <simd/simd.h>
    
    using namespace metal;
    
    fragment void main0()
    {
    }
    
*/
static const char object_shadow_fs_source_metal_ios[100] = {
    0x23,0x69,0x6e,0x63,0x6c,0x75,0x64,0x65,0x20,0x3c,0x6d,0x65,0x74,0x61,0x6c,0x5f,
    0x73,0x74,0x64,0x6c,0x69,0x62,0x3e,0x0a,0x23,0x69,0x6e,0x63,0x6c,0x75,0x64,0x65,
    0x20,0x3c,0x73,0x69,0x6d,0x64,0x2f,0x73,0x69,0x6d,0x64,0x2e,0x68,0x3e,0x0a,0x0a,
    0x75,0x73,0x69,0x6e,0x67,0x20,0x6e,0x61,0x6d,0x65,0x73,0x70,0x61,0x63,0x65,0x20,
    0x6d,0x65,0x74,0x61,0x6c,0x3b,0x0a,0x0a,0x66,0x72,0x61,0x67,0x6d,0x65,0x6e,0x74,
    0x20,0x76,0x6f,0x69,0x64,0x20,0x6d,0x61,0x69,0x6e,0x30,0x28,0x29,0x0a,0x7b,0x0a,
    0x7d,0x0a,0x0a,0x00,
};
#endif /* SOKOL_METAL */
#if defined(SOKOL_METAL)
/*
    #include <metal_stdlib>
    #include <simd/simd.h>
    
    using namespace metal;
    
    struct object_shadow_vs_params
    {
        float4x4 un_mvp;
    };
    
    struct main0_out
    {
        float4 gl_Position [[position]];
    };
    
    struct main0_in
    {
        float3 vs_position [[attribute(0)]];
    };
    
    vertex main0_out main0(main0_in in [[stage_in]], constant object_shadow_vs_params& _19 [[buffer(0)]])
    {
        main0_out out = {};
        out.gl_Position = _19.un_mvp * float4(in.vs_position, 1.0);
        return out;
    }
    
*/
static const char object_shadow_vs_source_metal_sim[465] = {
    0x23,0x69,0x6e,0x63,0x6c,0x75,0x64,0x65,0x20,0x3c,0x6d,0x65,0x74,0x61,0x6c,0x5f,
    0x73,0x74,0x64,0x6c,0x69,0x62,0x3e,0x0a,0x23,0x69,0x6e,0x63,0x6c,0x75,0x64,0x65,
    0x20,0x3c,0x73,0x69,0x6d,0x64,0x2f,0x73,0x69,0x6d,0x64,0x2e,0x68,0x3e,0x0a,0x0a,
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    0x00,
};
/*
    #include <metal_stdlib>
    #include <simd/simd.h>
    
    using namespace metal;
    
    fragment void main0()
    {
    }
    
*/
static const char object_shadow_fs_source_metal_sim[100] = {
    0x23,0x69,0x6e,0x63,0x6c,0x75,0x64,0x65,0x20,0x3c,0x6d,0x65,0x74,0x61,0x6c,0x5f,
    0x73,0x74,0x64,0x6c,0x69,0x62,0x3e,0x0a,0x23,0x69,0x6e,0x63,0x6c,0x75,0x64,0x65,
    0x20,0x3c,0x73,0x69,0x6d,0x64,0x2f,0x73,0x69,0x6d,0x64,0x2e,0x68,0x3e,0x0a,0x0a,
    0x75,0x73,0x69,0x6e,0x67,0x20,0x6e,0x61,0x6d,0x65,0x73,0x70,0x61,0x63,0x65,0x20,
    0x6d,0x65,0x74,0x61,0x6c,0x3b,0x0a,0x0a,0x66,0x72,0x61,0x67,0x6d,0x65,0x6e,0x74,
    0x20,0x76,0x6f,0x69,0x64,0x20,0x6d,0x61,0x69,0x6e,0x30,0x28,0x29,0x0a,0x7b,0x0a,
    0x7d,0x0a,0x0a,0x00,
};
#endif /* SOKOL_METAL */
#if !defined(SOKOL_GFX_INCLUDED)
  #error "Please include sokol_gfx.h before object_shadow.h"
#endif
static inline const sg_shader_desc* object_shadow_program_shader_desc(sg_backend backend) {
  #if defined(SOKOL_GLCORE33)
  if (backend == SG_BACKEND_GLCORE33) {
    static sg_shader_desc desc;
    static bool valid;
    if (!valid) {
      valid = true;
      desc.attrs[0].name = "vs_position";
      desc.vs.source = object_shadow_vs_source_glsl330;
      desc.vs.entry = "main";
      desc.vs.uniform_blocks[0].size = 64;
      desc.vs.uniform_blocks[0].layout = SG_UNIFORMLAYOUT_STD140;
      desc.vs.uniform_blocks[0].uniforms[0].name = "object_shadow_vs_params";
      desc.vs.uniform_blocks[0].uniforms[0].type = SG_UNIFORMTYPE_FLOAT4;
      desc.vs.uniform_blocks[0].uniforms[0].array_count = 4;
      desc.fs.source = object_shadow_fs_source_glsl330;
      desc.fs.entry = "main";
      desc.label = "object_shadow_program_shader";
    }
    return &desc;
  }
  #endif /* SOKOL_GLCORE33 */
  #if defined(SOKOL_GLES3)
  if (backend == SG_BACKEND_GLES3) {
    static sg_shader_desc desc;
    static bool valid;
    if (!valid) {
      valid = true;
      desc.attrs[0].name = "vs_position";
      desc.vs.source = object_shadow_vs_source_glsl300es;
      desc.vs.entry = "main";
      desc.vs.uniform_blocks[0].size = 64;
      desc.vs.uniform_blocks[0].layout = SG_UNIFORMLAYOUT_STD140;
      desc.vs.uniform_blocks[0].uniforms[0].name = "object_shadow_vs_params";
      desc.vs.uniform_blocks[0].uniforms[0].type = SG_UNIFORMTYPE_FLOAT4;
      desc.vs.uniform_blocks[0].uniforms[0].array_count = 4;
      desc.fs.source = object_shadow_fs_source_glsl300es;
      desc.fs.entry = "main";
      desc.label = "object_shadow_program_shader";
    }
    return &desc;
  }
  #endif /* SOKOL_GLES3 */
  #if defined(SOKOL_D3D11)
  if (backend == SG_BACKEND_D3D11) {
    static sg_shader_desc desc;
    static bool valid;
    if (!valid) {
      valid = true;
      desc.attrs[0].sem_name = "TEXCOORD";
      desc.attrs[0].sem_index = 0;
      desc.vs.source = object_shadow_vs_source_hlsl5;
      desc.vs.d3d11_target = "vs_5_0";
      desc.vs.entry = "main";
      desc.vs.uniform_blocks[0].size = 64;
      desc.vs.uniform_blocks[0].layout = SG_UNIFORMLAYOUT_STD140;
      desc.fs.source = object_shadow_fs_source_hlsl5;
      desc.fs.d3d11_target = "ps_5_0";
      desc.fs.entry = "main";
      desc.label = "object_shadow_program_shader";
    }
    return &desc;
  }
  #endif /* SOKOL_D3D11 */
  #if defined(SOKOL_METAL)
  if (backend == SG_BACKEND_METAL_MACOS) {
    static sg_shader_desc desc;
    static bool valid;
    if (!valid) {
      valid = true;
      desc.vs.source = object_shadow_vs_source_metal_macos;
      desc.vs.entry = "main0";
      desc.vs.uniform_blocks[0].size = 64;
      desc.vs.uniform_blocks[0].layout = SG_UNIFORMLAYOUT_STD140;
      desc.fs.source = object_shadow_fs_source_metal_macos;
      desc.fs.entry = "main0";
      desc.label = "object_shadow_program_shader";
    }
    return &desc;
  }
  #endif /* SOKOL_METAL */
  #if defined(SOKOL_METAL)
  if (backend == SG_BACKEND_METAL_IOS) {
    static sg_shader_desc desc;
    static bool valid;
    if (!valid) {
      valid = true;
      desc.vs.source = object_shadow_vs_source_metal_ios;
      desc.vs.entry = "main0";
      desc.vs.uniform_blocks[0].size = 64;
      desc.vs.uniform_blocks[0].layout = SG_UNIFORMLAYOUT_STD140;
      desc.fs.source = object_shadow_fs_source_metal_ios;
      desc.fs.entry = "main0";
      desc.label = "object_shadow_program_shader";
    }
    return &desc;
  }
  #endif /* SOKOL_METAL */
  #if defined(SOKOL_METAL)
  if (backend == SG_BACKEND_METAL_SIMULATOR) {
    static sg_shader_desc desc;
    static bool valid;
    if (!valid) {
      valid = true;
      desc.vs.source = object_shadow_vs_source_metal_sim;
      desc.vs.entry = "main0";
      desc.vs.uniform_blocks[0].size = 64;
      desc.vs.uniform_blocks[0].layout = SG_UNIFORMLAYOUT_STD140;
      desc.fs.source = object_shadow_fs_source_metal_sim;
      desc.fs.entry = "main0";
      desc.label = "object_shadow_program_shader";
    }
    return &desc;
  }
  #endif /* SOKOL_METAL */
  return 0;
}
static inline int object_shadow_program_attr_slot(const char* attr_name) {
  (void)attr_name;
  if (0 == strcmp(attr_name, "vs_position")) {
    return 0;
  }
  return -1;
}
static inline int object_shadow_program_image_slot(sg_shader_stage stage, const char* img_name) {
  (void)stage; (void)img_name;
  return -1;
}
static inline int object_shadow_program_sampler_slot(sg_shader_stage stage, const char* smp_name) {
  (void)stage; (void)smp_name;
  return -1;
}
static inline int object_shadow_program_uniformblock_slot(sg_shader_stage stage, const char* ub_name) {
  (void)stage; (void)ub_name;
  if (SG_SHADERSTAGE_VS == stage) {
    if (0 == strcmp(ub_name, "object_shadow_vs_params")) {
      return 0;
    }
  }
  return -1;
}
static inline size_t object_shadow_program_uniformblock_size(sg_shader_stage stage, const char* ub_name) {
  (void)stage; (void)ub_name;
  if (SG_SHADERSTAGE_VS == stage) {
    if (0 == strcmp(ub_name, "object_shadow_vs_params")) {
      return sizeof(object_shadow_object_shadow_vs_params_t);
    }
  }
  return 0;
}
static inline int object_shadow_program_uniform_offset(sg_shader_stage stage, const char* ub_name, const char* u_name) {
  (void)stage; (void)ub_name; (void)u_name;
  if (SG_SHADERSTAGE_VS == stage) {
    if (0 == strcmp(ub_name, "object_shadow_vs_params")) {
      if (0 == strcmp(u_name, "un_mvp")) {
        return 0;
      }
    }
  }
  return -1;
}
static inline sg_shader_uniform_desc object_shadow_program_uniform_desc(sg_shader_stage stage, const char* ub_name, const char* u_name) {
  (void)stage; (void)ub_name; (void)u_name;
  #if defined(__cplusplus)
  sg_shader_uniform_desc desc = {};
  #else
  sg_shader_uniform_desc desc = {0};
  #endif
  if (SG_SHADERSTAGE_VS == stage) {
    if (0 == strcmp(ub_name, "object_shadow_vs_params")) {
      if (0 == strcmp(u_name, "un_mvp")) {
        desc.name = "un_mvp";
        desc.type = SG_UNIFORMTYPE_MAT4;
        desc.array_count = 1;
        return desc;
      }
    }
  }
  return desc;
}
